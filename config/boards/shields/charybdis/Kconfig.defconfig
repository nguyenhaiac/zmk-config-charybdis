## config/boards/shields/charybdis/Kconfig.defconfig
```kconfig
if SHIELD_CHARYBDIS_DONGLE

config ZMK_KEYBOARD_NAME
	default "Charybdis_ble"


config ZMK_SPLIT_BLE_ROLE_CENTRAL
    default y

config ZMK_SPLIT_BLE_CENTRAL_PERIPHERALS
    default 3


endif

if SHIELD_CHARYBDIS_LEFT || SHIELD_CHARYBDIS_RIGHT || SHIELD_CHARYBDIS_DONGLE

config ZMK_SPLIT
	default y
	
endif
```
